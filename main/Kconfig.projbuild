## main/Kconfig.projbuild
```kconfig
menu "WiFi Configuration"

    config WIFI_SSID
        string "WiFi SSID"
        default "myssid"
        help
            SSID (network name) for the ESP8266 to connect to.

    config WIFI_PASSWORD
        string "WiFi Password"
        default "mypassword"
        help
            WiFi password (WPA or WPA2) for the ESP8266 to use.

    config WIFI_MAXIMUM_RETRY
        int "Maximum retry"
        default 5
        help
            Set the Maximum retry to avoid station reconnecting to the AP unlimited when the AP is really inexistent.

endmenu

menu "NTP Configuration"

    config NTP_SERVER_1
        string "NTP Server 1"
        default "pool.ntp.org"
        help
            Primary NTP server for time synchronization.

    config NTP_SERVER_2
        string "NTP Server 2"
        default "time.google.com"
        help
            Secondary NTP server for time synchronization.

    config NTP_SERVER_3
        string "NTP Server 3"
        default "time.cloudflare.com"
        help
            Tertiary NTP server for time synchronization.

    config TIMEZONE_OFFSET
        int "Timezone offset in hours"
        default 0
        range -12 14
        help
            Timezone offset from UTC in hours. Examples: 0 for UTC, 1 for CET, -5 for EST, 8 for CST.

endmenu

menu "Timer Configuration"

    config RELAY_GPIO_PIN
        int "Relay GPIO Pin"
        default 5
        range 0 16
        help
            GPIO pin number connected to the relay. Default is GPIO 5 (D1 on NodeMCU).
            Note: GPIO 6-11 are used for flash on most ESP8266 modules.

    config HTTPS_SERVER_PORT
        int "HTTPS Server Port"
        default 443
        range 1 65535
        help
            Port number for the HTTPS server. Default is 443.

    config RELAY_ACTIVE_HIGH
        bool "Relay Active High"
        default y
        help
            If enabled, relay turns ON with HIGH signal (1).
            If disabled, relay turns ON with LOW signal (0).

endmenu
```

## sdkconfig.defaults
```kconfig
# ESP8266 SDK Configuration Defaults

# Bootloader config
CONFIG_BOOTLOADER_LOG_LEVEL_INFO=y

# Serial flasher config
CONFIG_ESPTOOLPY_FLASHSIZE_2MB=y
CONFIG_ESPTOOLPY_FLASHSIZE="2MB"
CONFIG_ESPTOOLPY_FLASHMODE_DIO=y
CONFIG_ESPTOOLPY_FLASHFREQ_40M=y

# Partition Table
CONFIG_PARTITION_TABLE_SINGLE_APP=y

# Compiler options
CONFIG_COMPILER_OPTIMIZATION_SIZE=y

# ESP8266-specific
CONFIG_ESP8266_BOOT_COPY_APP=y

# WiFi
CONFIG_ESP8266_WIFI_CONNECT_RETRIES=10
CONFIG_ESP8266_SCAN_METHOD_ALL_CHANNEL=y

# LWIP
CONFIG_LWIP_MAX_SOCKETS=10
CONFIG_LWIP_SO_REUSE=y
CONFIG_LWIP_SO_RCVBUF=y
CONFIG_LWIP_NETIF_LOOPBACK=y

# SNTP
CONFIG_LWIP_SNTP_MAX_SERVERS=3
CONFIG_LWIP_DHCP_GET_NTP_SRV=y

# HTTP Server
CONFIG_HTTPD_MAX_REQ_HDR_LEN=512
CONFIG_HTTPD_MAX_URI_LEN=512

# mbedTLS
CONFIG_MBEDTLS_SSL_MAX_CONTENT_LEN=8192
CONFIG_MBEDTLS_ASYMMETRIC_CONTENT_LEN=y
CONFIG_MBEDTLS_SSL_IN_CONTENT_LEN=8192
CONFIG_MBEDTLS_SSL_OUT_CONTENT_LEN=4096

# FreeRTOS
CONFIG_FREERTOS_HZ=100
CONFIG_FREERTOS_UNICORE=y

# Task WDT
CONFIG_ESP_TASK_WDT=y
CONFIG_ESP_TASK_WDT_TIMEOUT_S=10

# Log output
CONFIG_LOG_DEFAULT_LEVEL_INFO=y
CONFIG_LOG_COLORS=y

# NVS
CONFIG_NVS_ENCRYPTION=n
```
